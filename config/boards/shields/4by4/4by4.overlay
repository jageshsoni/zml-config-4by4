/*
 * Copyright (c) 2020 Pete Johanson, Richard Jones
 *
 * SPDX-License-Identifier: MIT
 */


#include <dt-bindings/zmk/matrix_transform.h>
/ {
    chosen {
        zmk,kscan = &kscan0;
    };

    kscan0: kscan {
        compatible = "zmk,kscan-gpio-direct";
        label = "KSCAN";

        input-gpios = 
         <&gpio0 31 (GPIO_ACTIVE_LOW | GPIO_PULL_UP)>
        ,<&gpio0 29 (GPIO_ACTIVE_LOW | GPIO_PULL_UP)>
        ,<&gpio0 02 (GPIO_ACTIVE_LOW | GPIO_PULL_UP)>
        ,<&gpio1 15 (GPIO_ACTIVE_LOW | GPIO_PULL_UP)>
        ,<&gpio1 13 (GPIO_ACTIVE_LOW | GPIO_PULL_UP)>
        ,<&gpio1 11 (GPIO_ACTIVE_LOW | GPIO_PULL_UP)>
        ,<&gpio0 10 (GPIO_ACTIVE_LOW | GPIO_PULL_UP)>
        ,<&gpio0 09 (GPIO_ACTIVE_LOW | GPIO_PULL_UP)>
        ,<&gpio1 06  (GPIO_ACTIVE_LOW | GPIO_PULL_UP)>
        ,<&gpio1 04  (GPIO_ACTIVE_LOW | GPIO_PULL_UP)>
        ,<&gpio0 11 (GPIO_ACTIVE_LOW | GPIO_PULL_UP)>
        ,<&gpio1 00 (GPIO_ACTIVE_LOW | GPIO_PULL_UP)>
        ,<&gpio0 24  (GPIO_ACTIVE_LOW | GPIO_PULL_UP)>
        ,<&gpio0 22  (GPIO_ACTIVE_LOW | GPIO_PULL_UP)>
        ,<&gpio0 20 (GPIO_ACTIVE_LOW | GPIO_PULL_UP)>
        ,< &gpio0 17 (GPIO_ACTIVE_LOW | GPIO_PULL_UP)>
        ;
    };
};
