## config/boards/shields/4by4/Kconfig.defconfig
```kconfig
# Copyright (c) 2020 Pete Johanson, Richard Jones
# SPDX-License-Identifier: MIT

if SHIELD_4BY4

config ZMK_KEYBOARD_NAME
    default "4by4"

endif
```

## config/boards/shields/4by4/Kconfig.shield
```kconfig
# Copyright (c) 2020 Pete Johanson, Richard Jones
# SPDX-License-Identifier: MIT

config SHIELD_4BY4
    def_bool $(shields_list_contains,4by4)
```
